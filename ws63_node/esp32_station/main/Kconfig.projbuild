## ws63_node/esp32_station/main/Kconfig.projbuild
```kconfig
menu "Aisle site station"

config AISLE_STATION_RGB_GPIO
    int "Addressable RGB LED GPIO"
    range 1 48
    default 38

endmenu
```

## ws63_node/esp32_station/sdkconfig.defaults
```kconfig
CONFIG_IDF_TARGET="esp32s3"
CONFIG_ESPTOOLPY_OCT_FLASH=y
CONFIG_ESPTOOLPY_FLASHMODE_OPI=y
CONFIG_ESPTOOLPY_FLASHFREQ_40M=y
CONFIG_ESPTOOLPY_FLASHSIZE_32MB=y
CONFIG_ESP_CONSOLE_NONE=y
CONFIG_ESP_CONSOLE_SECONDARY_NONE=y
```
